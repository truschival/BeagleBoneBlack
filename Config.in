## Config.in
```kconfig
#-------------------------------------------------------------------------------
menu "Pre-Build Distibution Options"

config SRC_BIN_PRE_BUILT_DIR
	string "Store Pre-Builts in"
	default "$(BASE_DIR)/pre-builts"
	help
	Output directory for pre-built packag tar balls
	the default is "$(BASE_DIR)/pre-builts"

choice
	prompt"Select default distribuiton"
	default SRC_BIN_CHOOSE_SOURCE_FORMAT
	help
	Select default source format for packages

config SRC_BIN_DOWNLOAD_SRC
	bool "Build Sources"
	help
		Build and install all packages from source.

config SRC_BIN_DOWNLOAD_BIN_ONLY
	bool "Download binaries only"
	help
	Download all custom packages as binary

config SRC_BIN_CHOOSE_SOURCE_FORMAT
	bool "Choose for each package"
	help
	Choose packages individually
	This is the default behavior.

endchoice

endmenu # Source-Bin

#-------------------------------------------------------------------------------

menu "Transmogrification Tools"
	comment "Simple demo packages"
	source "$BR2_EXTERNAL/package/transmogrify/Config.in"

	comment "Transmogclient depends on Libtransmog"
	source "$BR2_EXTERNAL/package/libtransmog/Config.in"
endmenu

#-------------------------------------------------------------------------------
```

## configs/bbb_defconfig
```kconfig
BR2_arm=y
BR2_cortex_a8=y
BR2_ARM_EABIHF=y
BR2_TOOLCHAIN_EXTERNAL=y
BR2_TOOLCHAIN_EXTERNAL_PREINSTALLED=y
BR2_TOOLCHAIN_EXTERNAL_PATH="/opt/gcc-linaro-arm-linux-gnueabihf-4.9-2014.09_linux/"
BR2_TOOLCHAIN_EXTERNAL_GDB_SERVER_COPY=y
BR2_ENABLE_LOCALE_PURGE=y
BR2_ENABLE_LOCALE_WHITELIST="C en_US de"
BR2_TARGET_GENERIC_HOSTNAME="BeagleBone"
BR2_TARGET_GENERIC_GETTY_PORT="ttyO0"
# BR2_TARGET_GENERIC_REMOUNT_ROOTFS_RW is not set
BR2_ROOTFS_POST_IMAGE_SCRIPT="${BR2_EXTERNAL}/board/bbb/post-image.sh"
BR2_LINUX_KERNEL=y
BR2_LINUX_KERNEL_CUSTOM_LOCAL=y
BR2_LINUX_KERNEL_CUSTOM_LOCAL_PATH="/usr/src/linux"
BR2_LINUX_KERNEL_PATCH="${BR2_EXTERNAL}/board/bbb/patches/linux/"
BR2_LINUX_KERNEL_USE_CUSTOM_CONFIG=y
BR2_LINUX_KERNEL_CUSTOM_CONFIG_FILE="${BR2_EXTERNAL}/board/bbb/linux.config"
BR2_LINUX_KERNEL_ZIMAGE=y
BR2_LINUX_KERNEL_DTS_SUPPORT=y
BR2_LINUX_KERNEL_INTREE_DTS_NAME="am335x-bone am335x-boneblack"
BR2_PACKAGE_AM33X_CM3=y
BR2_TARGET_ROOTFS_EXT2=y
# BR2_TARGET_ROOTFS_TAR is not set
BR2_TARGET_UBOOT=y
BR2_TARGET_UBOOT_BOARDNAME="am335x_evm"
BR2_TARGET_UBOOT_CUSTOM_VERSION=y
BR2_TARGET_UBOOT_CUSTOM_VERSION_VALUE="2013.10"
BR2_TARGET_UBOOT_FORMAT_IMG=y
BR2_TARGET_UBOOT_SPL=y
BR2_TARGET_UBOOT_SPL_NAME="MLO"
SRC_BIN_DEMO_PKGS=y
BR2_PACKAGE_TRANSMOGRIFY=y
BR2_PACKAGE_TRANSMOGRIFY_SRC=y
BR2_PACKAGE_TRANSMOGRIFY_DEVEL=y
BR2_PACKAGE_LIBTRANSMOG=y
BR2_PACKAGE_LIBTRANSMOG_SRC=y
```

## package/libtransmog/Config.in
```kconfig
config BR2_PACKAGE_LIBTRANSMOG
       bool "Libtransmog"
       help
       Highly optimized transmogrification library

if BR2_PACKAGE_LIBTRANSMOG

config BR2_PACKAGE_LIBTRANSMOG_SRC
       bool "Build from source" if !SRC_BIN_DOWNLOAD_SRC
       depends on !SRC_BIN_DOWNLOAD_BIN_ONLY
       help
       Say yes here if you want to rebuild the package


config BR2_PACKAGE_LIBTRANSMOG_MAGIC_MOJO
	   int
	   prompt "Magic transmogrification mojo"
	   depends on BR2_PACKAGE_LIBTRANSMOG_SRC
	   default 13
	   help
	   Magic number to alter the transmogrification result


### Version selection
choice
   prompt "Package Version"

config BR2_PACKAGE_LIBTRANSMOG_VERSION_STABLE
       bool "master"
       help
       Stable branch

config BR2_PACKAGE_LIBTRANSMOG_VERSION_DEVEL
   bool "develop"
   help
   Bleeding edge features


config BR2_PACKAGE_LIBTRANSMOG_VERSION_CUSTOM
   bool "custom"
   help
   Bleeding edge features

endchoice


if BR2_PACKAGE_LIBTRANSMOG_VERSION_CUSTOM

config BR2_PACKAGE_LIBTRANSMOG_VERSION_CUSTOM_STRING
       string "custom version"
       help
       Custom (Git-) revision
endif

config BR2_PACKAGE_LIBTRANSMOG_VERSION
       string
       default "master" if BR2_PACKAGE_LIBTRANSMOG_VERSION_STABLE
       default "develop" if BR2_PACKAGE_LIBTRANSMOG_VERSION_DEVEL
       default BR2_PACKAGE_LIBTRANSMOG_VERSION_CUSTOM_STRING  if BR2_PACKAGE_LIBTRANSMOG_VERSION_CUSTOM

endif #package
```

## package/transmogrify/Config.in
```kconfig
config BR2_PACKAGE_TRANSMOGRIFY
       bool "Transmogrify Client"
	   depends on BR2_PACKAGE_LIBTRANSMOG
	   help
		Program using libtransmogrify

if BR2_PACKAGE_TRANSMOGRIFY

config BR2_PACKAGE_TRANSMOGRIFY_SRC
	  bool "Build from source" if !SRC_BIN_DOWNLOAD_SRC
	  depends on !SRC_BIN_DOWNLOAD_BIN_ONLY
	  help
		Say yes here if you want to rebuild the package


### Version selection
choice
	prompt "Package Version"

config BR2_PACKAGE_TRANSMOGRIFY_STABLE
   bool "master"
   help
   Stable branch

config BR2_PACKAGE_TRANSMOGRIFY_DEVEL
   bool "develop"
   default false
   help
   Bleeding edge features

endchoice



endif #package
```
